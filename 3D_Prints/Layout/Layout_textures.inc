#include "metals.inc"
#declare Motor_material = material { 
	texture { Brushed_Aluminum
	}
}

#declare Bracket1_material = material { 
	texture { 
		pigment { color Black }
	finish {
	ambient 0.35
brilliance 2
diffuse 0.3
metallic
specular 0.80
roughness 1/20
reflection 0.1	}
	}
}

#declare Bracket2_material = material { 
	texture { 
		pigment { color Black }
	finish {
	ambient 0.35
brilliance 2
diffuse 0.3
metallic
specular 0.80
roughness 1/20
reflection 0.1	}
	}
}

#declare DrivingWheel_material = material { 
	texture { 
		pigment { color Black }
	finish {
	ambient 0.35
brilliance 2
diffuse 0.3
metallic
specular 0.80
roughness 1/20
reflection 0.1	}
	}
}

#declare MainHolder002_material = material { 
	texture { 
		pigment { color Black }
	finish {
	ambient 0.35
brilliance 2
diffuse 0.3
metallic
specular 0.80
roughness 1/20
reflection 0.1	}
	}
}

#include "metals.inc"
#declare Reel_material = material { 
	texture { Spun_Brass
	}
}

#declare Horseshoe_material = material { 
	texture { 
		pigment { color Black }
	finish {
	ambient 0.35
brilliance 2
diffuse 0.3
metallic
specular 0.80
roughness 1/20
reflection 0.1	}
	}
}

#include "metals.inc"
#declare Lamp_material = material { 
	texture { Silver_Metal
	}
}

#include "metals.inc"
#declare TapeHead_material = material { 
	texture { Brushed_Aluminum
	}
}

#include "metals.inc"
#declare Reel001_material = material { 
	texture { Spun_Brass
	}
}

#declare Guide_material = material { 
	texture { 
		pigment { color Black }
	finish {
	ambient 0.35
brilliance 2
diffuse 0.3
metallic
specular 0.80
roughness 1/20
reflection 0.1	}
	}
}

#declare Guide001_material = material { 
	texture { 
		pigment { color Black }
	finish {
	ambient 0.35
brilliance 2
diffuse 0.3
metallic
specular 0.80
roughness 1/20
reflection 0.1	}
	}
}

#include "woods.inc"
#declare Base_material = material { 
	texture { T_Wood8
	}
	scale <50.0, 50.0, 50.0>
	rotate <90.0, 0.0, 0.0>
}

#include "glass.inc"
#declare Film_material = material { M_Glass3
	texture { 
		pigment { Col_Glass_Winebottle }
	}
	interior {
	I_Glass_Dispersion1
	}
}

#include "metals.inc"
#declare _4_mmx12_Screw_material = material { 
	texture { Chrome_Metal
	}
}

#include "metals.inc"
#declare _4_mmx12_Screw001_material = material { 
	texture { Chrome_Metal
	}
}

#include "metals.inc"
#declare _4_mmx12_Screw002_material = material { 
	texture { Chrome_Metal
	}
}

#include "metals.inc"
#declare _4_mmx12_Screw003_material = material { 
	texture { Chrome_Metal
	}
}

#include "metals.inc"
#declare _4_mmx12_Screw004_material = material { 
	texture { Chrome_Metal
	}
}

#include "metals.inc"
#declare _4_mmx12_Screw005_material = material { 
	texture { Chrome_Metal
	}
}

#include "metals.inc"
#declare _4_mmx12_Screw006_material = material { 
	texture { Chrome_Metal
	}
}

#include "metals.inc"
#declare _4_mmx12_Screw007_material = material { 
	texture { Chrome_Metal
	}
}

#include "metals.inc"
#declare _4_mmx12_Screw008_material = material { 
	texture { Chrome_Metal
	}
}

#include "metals.inc"
#declare _4_mmx12_Screw009_material = material { 
	texture { Chrome_Metal
	}
}

#include "metals.inc"
#declare _4_mmx12_Screw010_material = material { 
	texture { Chrome_Metal
	}
}

#include "metals.inc"
#declare M3x8_Screw_material = material { 
	texture { Chrome_Metal
	}
}

#include "metals.inc"
#declare M3_Nut_material = material { 
	texture { Chrome_Metal
	}
}

#include "metals.inc"
#declare M3_Nut001_material = material { 
	texture { Chrome_Metal
	}
}

#include "metals.inc"
#declare M3x8_Screw001_material = material { 
	texture { Chrome_Metal
	}
}

#declare TapeHeadBase_material = material { 
	texture { 
		pigment { color Black }
	finish {
	ambient 0.35
brilliance 2
diffuse 0.3
metallic
specular 0.80
roughness 1/20
reflection 0.1	}
	}
}

#include "metals.inc"
#declare _4_mmx12_Screw011_material = material { 
	texture { Chrome_Metal
	}
}

#include "metals.inc"
#declare _4_mmx12_Screw012_material = material { 
	texture { Chrome_Metal
	}
}

#include "metals.inc"
#declare M3x8_Screw013_material = material { 
	texture { Chrome_Metal
	}
}

#include "metals.inc"
#declare M3x8_Screw003_material = material { 
	texture { Chrome_Metal
	}
}

#include "metals.inc"
#declare M3x8_Screw005_material = material { 
	texture { Chrome_Metal
	}
}

#declare TopCover001_material = material { 
	texture { 
		pigment { color Black }
	finish {
	ambient 0.35
brilliance 2
diffuse 0.3
metallic
specular 0.80
roughness 1/20
reflection 0.1	}
	}
}

#declare BottomCover001_material = material { 
	texture { 
		pigment { color Black }
	finish {
	ambient 0.35
brilliance 2
diffuse 0.3
metallic
specular 0.80
roughness 1/20
reflection 0.1	}
	}
}

#include "metals.inc"
#declare M3x8_Screw007_material = material { 
	texture { Chrome_Metal
	}
}

#include "metals.inc"
#declare M3x8_Screw008_material = material { 
	texture { Chrome_Metal
	}
}

#include "metals.inc"
#declare M3x8_Screw009_material = material { 
	texture { Chrome_Metal
	}
}

#include "metals.inc"
#declare M3x8_Screw010_material = material { 
	texture { Chrome_Metal
	}
}

#include "metals.inc"
#declare M3x8_Screw011_material = material { 
	texture { Chrome_Metal
	}
}

#include "metals.inc"
#declare M3x8_Screw012_material = material { 
	texture { Chrome_Metal
	}
}

